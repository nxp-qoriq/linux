## Documentation/devicetree/bindings/net/dpaa-backplane.txt
```
=============================================================================
DPAA Backplane Device Bindings

CONTENTS
  - SerDes Node
  - PCS Phy Node

=============================================================================
SerDes Node

DESCRIPTION

SerDes (Serializer/Deserializer) HW peripheral

PROPERTIES

- compatible
		Usage: required
		Value type: <stringlist>
		Definition: Specifies the type of SerDes.
		Must include the prefix "fsl,serdes"
		SerDes can be of different types:
		- 10G SerDes must be specified as: "fsl,serdes-10g"
		- 28G SerDes must be specified as: "fsl,serdes-28g"

- reg
		Usage: required
		Value type: <prop-encoded-array>
		Definition: Specifies the offset of the SerDes configuration registers

- little-endian
		Usage: optional
		Value type: <Boolean>
		Definition: Specifies endianness access to SerDes registers.
		If omitted, big-endian will be used
		See common-properties.txt for complete definition

EXAMPLE

Example of 10G SerDes node:

serdes1: serdes@1ea0000 {
		compatible = "fsl,serdes-10g";
		reg = <0x0 0x1ea0000 0 0x00002000>;
		little-endian;
};

=============================================================================
PCS Phy Node

DESCRIPTION

PCS Phy (Physical Coding Sublayer / Physical layer) node

PROPERTIES

- compatible
		Usage: required
		Value type: <stringlist>
		Definition: A standard property. Specifies the IEEE 802.3 Clause
		Different IEEE 802.3 Clauses can be specified:
		- Clause 22 must be specified as: "ethernet-phy-ieee802.3-c22"
		- Clause 45 must be specified as: "ethernet-phy-ieee802.3-c45"
		For complete definition see:
		Documentation/devicetree/bindings/net/phy.txt

- reg
		Usage: required
		Value type: <prop-encoded-array>
		Definition: A standard property. 
		Specifies the offset of the PCS Phy configuration registers
		For complete definition see:
		Documentation/devicetree/bindings/net/phy.txt		

- backplane-mode
		Usage: required
		Value type: <stringlist>
		Definition: Specifies the speed and type of the protocol used
		Different speeds and backplane protocol types can be used:
		- 10GBase-KR must be specified as: "10gbase-kr"
		- 40GBase-KR must be specified as: "40gbase-kr"

- fsl,lane-handle
		Usage: required
		Value type: <phandle>
		Definition: Specifies the reference to a node representing the SerDes
		device

- fsl,lane-reg
		Usage: required
		Value type: <prop-encoded-array>
		Definition: Specifies the offsets of the SerDes lanes configuration
		registers

EXAMPLE

Example of pcs phy node for 10GBase-KR:

pcs_phy1: ethernet-phy@0 {
	compatible = "ethernet-phy-ieee802.3-c45";
	backplane-mode = "10gbase-kr";
	reg = <0x0>;
	fsl,lane-handle = <&serdes1>;
	fsl,lane-reg = <0xE00>; /* lane G */
};
```

## Documentation/devicetree/bindings/pci/layerscape-pci.txt
```
====================================
Freescale Layerscape PCIe controller
====================================

This PCIe host controller is based on the Synopsys DesignWare PCIe IP
and thus inherits all the common properties defined in designware-pcie.txt.

This controller derives its clocks from the Reset Configuration Word (RCW)
which is used to describe the PLL settings at the time of chip-reset.

Also as per the available Reference Manuals, there is no specific 'version'
register available in the Freescale PCIe controller register set,
which can allow determining the underlying DesignWare PCIe controller version
information.

Required properties:
- compatible: should contain the platform identifier such as:
  RC mode:
        "fsl,ls1021a-pcie", "snps,dw-pcie"
        "fsl,ls2080a-pcie", "fsl,ls2085a-pcie", "snps,dw-pcie"
        "fsl,ls2088a-pcie"
        "fsl,ls1088a-pcie"
        "fsl,ls1046a-pcie"
        "fsl,ls1028a-pcie"
        "fsl,ls1012a-pcie"
  EP mode:
	"fsl,ls1046a-pcie-ep", "fsl,ls-pcie-ep"
- reg: base addresses and lengths of the PCIe controller register blocks.
- interrupts: A list of interrupt outputs of the controller. Must contain an
  entry for each entry in the interrupt-names property.
- interrupt-names: It could include the following entries:
  "aer": Asserted for aer interrupt when chip support the aer interrupt with
		 none MSI/MSI-X/INTx mode,but there is interrupt line for aer.
  "pme": Asserted for pme interrupt when chip support the pme interrupt with
		 none MSI/MSI-X/INTx mode,but there is interrupt line for pme.
  ......
- fsl,pcie-scfg: Must include two entries.
  The first entry must be a link to the SCFG device node
  The second entry must be '0' or '1' based on physical PCIe controller index.
  This is used to get SCFG PEXN registers
- dma-coherent: Indicates that the hardware IP block can ensure the coherency
  of the data transferred from/to the IP block. This can avoid the software
  cache flush/invalid actions, and improve the performance significantly.

Example:

	pcie@3400000 {
		compatible = "fsl,ls1021a-pcie", "snps,dw-pcie";
		reg = <0x00 0x03400000 0x0 0x00010000   /* controller registers */
		       0x40 0x00000000 0x0 0x00002000>; /* configuration space */
		reg-names = "regs", "config";
		interrupts = <GIC_SPI 176 IRQ_TYPE_LEVEL_HIGH>, /* aer interrupt */
			<GIC_SPI 177 IRQ_TYPE_LEVEL_HIGH>; /* pme interrupt */
		interrupt-names = "aer", "pme";
		fsl,pcie-scfg = <&scfg 0>;
		#address-cells = <3>;
		#size-cells = <2>;
		device_type = "pci";
		dma-coherent;
		num-lanes = <4>;
		bus-range = <0x0 0xff>;
		ranges = <0x81000000 0x0 0x00000000 0x40 0x00010000 0x0 0x00010000   /* downstream I/O */
			  0xc2000000 0x0 0x20000000 0x40 0x20000000 0x0 0x20000000   /* prefetchable memory */
			  0x82000000 0x0 0x40000000 0x40 0x40000000 0x0 0x40000000>; /* non-prefetchable memory */
		#interrupt-cells = <1>;
		interrupt-map-mask = <0 0 0 7>;
		interrupt-map = <0000 0 0 1 &gic GIC_SPI 91  IRQ_TYPE_LEVEL_HIGH>,
				<0000 0 0 2 &gic GIC_SPI 188 IRQ_TYPE_LEVEL_HIGH>,
				<0000 0 0 3 &gic GIC_SPI 190 IRQ_TYPE_LEVEL_HIGH>,
				<0000 0 0 4 &gic GIC_SPI 192 IRQ_TYPE_LEVEL_HIGH>;
	};

===================================
NXP Layerscape PCIe Gen4 controller
===================================

This PCIe controller is based on the Mobiveil PCIe IP and thus inherits all
the common properties defined in mobiveil-pcie.txt.

Required properties:
- compatible: should contain the platform identifier such as:
  RC mode:
	"fsl,lx2160a-pcie"
  EP mode:
	"fsl,lx2160a-pcie-ep"
- reg: base addresses and lengths of the PCIe controller register blocks.
  "config_axi_slave": PCIe controller registers
  "csr_axi_slave": Bridge config registers
- interrupts: A list of interrupt outputs of the controller. Must contain an
  entry for each entry in the interrupt-names property.
- interrupt-names: It could include the following entries:
  "intr": The interrupt that is asserted for controller interrupts
  "aer": Asserted for aer interrupt when chip support the aer interrupt with
	 none MSI/MSI-X/INTx mode,but there is interrupt line for aer.
  "pme": Asserted for pme interrupt when chip support the pme interrupt with
	 none MSI/MSI-X/INTx mode,but there is interrupt line for pme.
- dma-coherent: Indicates that the hardware IP block can ensure the coherency
  of the data transferred from/to the IP block. This can avoid the software
  cache flush/invalid actions, and improve the performance significantly.
- msi-parent : See the generic MSI binding described in
  Documentation/devicetree/bindings/interrupt-controller/msi.txt.

Example:

	pcie@3400000 {
		compatible = "fsl,lx2160a-pcie";
		reg = <0x00 0x03400000 0x0 0x00100000   /* controller registers */
		       0x80 0x00000000 0x0 0x00001000>; /* configuration space */
		reg-names = "csr_axi_slave", "config_axi_slave";
		interrupts = <GIC_SPI 108 IRQ_TYPE_LEVEL_HIGH>, /* AER interrupt */
			     <GIC_SPI 108 IRQ_TYPE_LEVEL_HIGH>, /* PME interrupt */
			     <GIC_SPI 108 IRQ_TYPE_LEVEL_HIGH>; /* controller interrupt */
		interrupt-names = "aer", "pme", "intr";
		#address-cells = <3>;
		#size-cells = <2>;
		device_type = "pci";
		apio-wins = <8>;
		ppio-wins = <8>;
		dma-coherent;
		bus-range = <0x0 0xff>;
		msi-parent = <&its>;
		ranges = <0x82000000 0x0 0x40000000 0x80 0x40000000 0x0 0x40000000>;
		#interrupt-cells = <1>;
		interrupt-map-mask = <0 0 0 7>;
		interrupt-map = <0000 0 0 1 &gic 0 0 GIC_SPI 109 IRQ_TYPE_LEVEL_HIGH>,
				<0000 0 0 2 &gic 0 0 GIC_SPI 110 IRQ_TYPE_LEVEL_HIGH>,
				<0000 0 0 3 &gic 0 0 GIC_SPI 111 IRQ_TYPE_LEVEL_HIGH>,
				<0000 0 0 4 &gic 0 0 GIC_SPI 112 IRQ_TYPE_LEVEL_HIGH>;
	};
```

## Documentation/devicetree/bindings/pci/mobiveil-pcie.txt
```
* Mobiveil PCIe interface

Required properties:
- reg: Should contain the configuration address space.
- reg-names: Must be "config" for the PCIe configuration space.
    (The old way of getting the configuration address space from "ranges"
    is deprecated and should be avoided.)
RC mode:
- #address-cells: set to <3>
- #size-cells: set to <2>
- device_type: set to "pci"
- ranges: ranges for the PCI memory and I/O regions
- #interrupt-cells: set to <1>
- interrupt-map-mask and interrupt-map: standard PCI properties to define
    the mapping of the PCIe interface to interrupt numbers.

Optional properties:
RC mode:
- apio-wins: number of outbound address translation windows
- ppio-wins-rc: number of inbound address translation windows
- bus-range: PCI bus numbers covered (it is recommended for new devicetrees
    to specify this property, to keep backwards compatibility a range of
    0x00-0xff is assumed if not present)

Example configuration:

	pcie@3400000 {
		compatible = "fsl,lx2160a-pcie";
		reg = <0x00 0x03400000 0x0 0x00100000   /* controller registers */
		       0x80 0x00000000 0x0 0x00020000>; /* configuration space */
		reg-names = "regs", "config";
		#address-cells = <3>;
		#size-cells = <2>;
		device_type = "pci";
		apio-wins = <3>;
		ppio-wins-rc = <3>;
		bus-range = <0x0 0xff>;
		ranges = <0x81000000 0x0 0x00000000 0x80 0x00020000 0x0 0x00010000
			  0x82000000 0x0 0x40000000 0x80 0x40000000 0x0 0x40000000>;
		#interrupt-cells = <1>;
		interrupt-map-mask = <0 0 0 7>;
		interrupt-map = <0000 0 0 1 &gic 0 109 0x4>,
				<0000 0 0 2 &gic 0 110 0x4>,
				<0000 0 0 3 &gic 0 111 0x4>,
				<0000 0 0 4 &gic 0 112 0x4>;
	};
```

## Documentation/devicetree/bindings/tty/rpmsg_tty.yaml
```yaml
# SPDX-License-Identifier: (GPL-2.0-only OR BSD-2-Clause)
%YAML 1.2
---
$id: http://devicetree.org/schemas/tty/rpmsg_tty.yaml#
$schema: http://devicetree.org/meta-schemas/core.yaml#

title: rpmsg tty driver

maintainers:
  - Biwen Li <biwen.li@nxp.com>

properties:
  compatible:
    const: fsl,uart-rpbus

  bus_id:
    items:
      - description: Used for imx srtm uart application protocol. Specify which real uart(LPUARTx/UARTx, x is instance number) will be used by a virtual tty(/dev/ttyRPMSGx), bus_id = 0xff when bus_id is not specified in dts and specified the flag(IMX_SRTM_UART_SUPPORT_MULTI_UART_MSG_FLAG).
    maxItems: 1

  flags:
    items:
      - description: used for imx srtm uart application protocol(IMX_SRTM_UART_SUPPORT_MULTI_UART_MSG_FLAG: support multi uart message protocol; IMX_SRTM_UART_SPECIFY_PORT_NUM_MASK: whether specify destination uart id; IMX_SRTM_UART_PORT_NUM_MASK: which destination uart id will be used)
    maxItems: 1

  status:
    maxItems: 1

examples:
  - |
    #include <dt-bindings/rpmsg/imx_srtm.h>

    uart-rpbus-0 {
        compatible = "fsl,uart-rpbus";
        bus_id = <3>; /* use uart3 */
        flags=<IMX_SRTM_UART_SUPPORT_MULTI_UART_MSG_FLAG>;
        status = "okay";
    }; /* /dev/ttyRPMSG0 on linux(running on acore) <--SRTM PROTOCOL--> srtm uart channel 0(endpoint on mcore) <---MULTI UART MSG PROTOCOL---> UART3(mcore is the owner) */

    uart-rpbus-1 {
        compatible = "fsl,uart-rpbus";
        bus_id = <3>; /* use uart3 */
        flags=<IMX_SRTM_UART_SUPPORT_MULTI_UART_MSG_FLAG>;
        status = "okay";
    }; /* /dev/ttyRPMSG1 on linux(running on acore) <--SRTM PROTOCOL--> srtm uart channel 1(endpoint on mcore) <---MULTI UART MSG PROTOCOL---> UART3(mcore is the owner) */

    uart-rpbus-2 {
        compatible = "fsl,uart-rpbus";
        bus_id = <2>; /* use uart2 */
        flags=<IMX_SRTM_UART_SUPPORT_MULTI_UART_MSG_FLAG>;
        status = "okay";
    }; /* /dev/ttyRPMSG2 on linux(running on acore) <--SRTM PROTOCOL--> srtm uart channel 2(endpoint on mcore) <---MULTI UART MSG PROTOCOL---> UART2(mcore is the owner) */

    uart-rpbus-3 {
        compatible = "fsl,uart-rpbus";
        bus_id = <4>; /* use uart4 */
        flags=<IMX_SRTM_UART_SUPPORT_MULTI_UART_MSG_FLAG | IMX_SRTM_UART_SPECIFY_PORT_NUM_MASK | IMX_SRTM_UART_PORT_NUM_MASK(0x8)>;
        status = "okay";
    }; /* [/dev/ttyRPMSG3 on linux(running on acore) <--SRTM PROTOCOL--> srtm uart channel 3(endpoint on mcore) <---MULTI UART MSG PROTOCOL---> UART4(mcore is the owner), first board] <---MULTI UART MSG PROTOCOL--> [UARTx(mcore is the owner) <---MULTI UART MSG PROTOCOL---> srtm uart channel 8 <---SRTM PROTOCOL--> /dev/ttyRPMSG8 on linux(running on acore), second board ] */

    uart-rpbus-4 {
        compatible = "fsl,uart-rpbus";
        bus_id = <5>; /* use uart5 */
        status = "okay";
    }; /* /dev/ttyRPMSG4 on linux(running on acore) <--SRTM PROTOCOL--> srtm uart channel 4(endpoint on mcore) <-----> UART5(mcore is the owner) <----> GPS device(The device have exclusive use of the UART5, other virtual tty cannot use UART5) */

    /* Note: when nothing is specified(include compatible, bus_id, flags, status), it's a normal rpmsg tty. /dev/ttyRPMSG7(running on acore) <--RPMSG--> rpmsg endpoint(running on mcore) */
```
