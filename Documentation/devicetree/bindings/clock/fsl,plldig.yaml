## arch/arm64/configs/ls1046a_min_defconfig
```kconfig
CONFIG_SYSVIPC=y
CONFIG_USELIB=y
CONFIG_NO_HZ_IDLE=y
CONFIG_HIGH_RES_TIMERS=y
CONFIG_BSD_PROCESS_ACCT=y
CONFIG_BSD_PROCESS_ACCT_V3=y
CONFIG_IKCONFIG=y
CONFIG_IKCONFIG_PROC=y
CONFIG_LOG_BUF_SHIFT=14
CONFIG_MEMCG=y
CONFIG_MEMCG_SWAP=y
CONFIG_CGROUP_HUGETLB=y
# CONFIG_UTS_NS is not set
# CONFIG_IPC_NS is not set
CONFIG_SCHED_AUTOGROUP=y
CONFIG_BLK_DEV_INITRD=y
CONFIG_KALLSYMS_ALL=y
# CONFIG_COMPAT_BRK is not set
CONFIG_SLAB=y
CONFIG_PROFILING=y
CONFIG_JUMP_LABEL=y
CONFIG_MODULES=y
CONFIG_MODULE_FORCE_LOAD=y
CONFIG_MODULE_UNLOAD=y
CONFIG_MODVERSIONS=y
# CONFIG_BLK_DEV_BSG is not set
# CONFIG_IOSCHED_DEADLINE is not set
CONFIG_ARCH_EXYNOS=y
CONFIG_ARCH_LAYERSCAPE=y
CONFIG_PCI=y
CONFIG_PCIEPORTBUS=y
CONFIG_PCI_LAYERSCAPE=y
CONFIG_PCI_HOST_GENERIC=y
CONFIG_ARM64_VA_BITS_48=y
CONFIG_HOTPLUG_CPU=y
CONFIG_KSM=y
CONFIG_TRANSPARENT_HUGEPAGE=y
CONFIG_CMA=y
CONFIG_CMDLINE="console=ttyAMA0"
# CONFIG_CORE_DUMP_DEFAULT_ELF_HEADERS is not set
CONFIG_COMPAT=y
# CONFIG_SUSPEND is not set
CONFIG_CPU_IDLE=y
CONFIG_CPU_IDLE_GOV_LADDER=y
CONFIG_ARM_CPUIDLE=y
CONFIG_CPU_FREQ=y
CONFIG_CPU_FREQ_STAT=y
CONFIG_CPU_FREQ_GOV_POWERSAVE=y
CONFIG_CPU_FREQ_GOV_USERSPACE=y
CONFIG_CPU_FREQ_GOV_ONDEMAND=y
CONFIG_CPU_FREQ_GOV_CONSERVATIVE=y
CONFIG_QORIQ_CPUFREQ=y
CONFIG_UEVENT_HELPER_PATH="/sbin/hotplug"
CONFIG_DEVTMPFS=y
CONFIG_DEVTMPFS_MOUNT=y
CONFIG_DMA_CMA=y
CONFIG_ARM_CCI400_PMU=y
CONFIG_BLK_DEV_LOOP=y
CONFIG_BLK_DEV_RAM=y
CONFIG_BLK_DEV_RAM_SIZE=262144
CONFIG_EEPROM_AT24=y
CONFIG_INPUT_MOUSEDEV=y
CONFIG_INPUT_MOUSEDEV_PSAUX=y
CONFIG_INPUT_EVDEV=y
# CONFIG_SERIO_SERPORT is not set
CONFIG_SERIO_AMBAKMI=y
CONFIG_LEGACY_PTY_COUNT=16
CONFIG_SERIAL_8250=y
CONFIG_SERIAL_8250_CONSOLE=y
CONFIG_SERIAL_OF_PLATFORM=y
CONFIG_SERIAL_AMBA_PL011=y
CONFIG_SERIAL_AMBA_PL011_CONSOLE=y
CONFIG_SERIAL_XILINX_PS_UART=y
CONFIG_SERIAL_XILINX_PS_UART_CONSOLE=y
CONFIG_SERIAL_FSL_LPUART=y
CONFIG_SERIAL_FSL_LPUART_CONSOLE=y
CONFIG_HW_RANDOM=y
CONFIG_I2C=y
CONFIG_I2C_CHARDEV=y
CONFIG_I2C_MUX=y
CONFIG_I2C_IMX=y
CONFIG_POWER_RESET_XGENE=y
CONFIG_POWER_RESET_SYSCON=y
# CONFIG_HWMON is not set
CONFIG_WATCHDOG=y
CONFIG_IMX2_WDT=y
CONFIG_FB=y
CONFIG_FB_ARMCLCD=y
CONFIG_FRAMEBUFFER_CONSOLE=y
CONFIG_LOGO=y
# CONFIG_LOGO_LINUX_MONO is not set
# CONFIG_LOGO_LINUX_VGA16 is not set
# CONFIG_HID is not set
# CONFIG_USB_SUPPORT is not set
CONFIG_DMADEVICES=y
CONFIG_FSL_QDMA=y
CONFIG_DMATEST=y
CONFIG_COMMON_CLK_VERSATILE=y
# CONFIG_COMMON_CLK_XGENE is not set
CONFIG_ARM_SMMU=y
CONFIG_LS_SOC_DRIVERS=y
# CONFIG_FSL_LS2_CONSOLE is not set
# CONFIG_PHY_EXYNOS_DP_VIDEO is not set
# CONFIG_PHY_EXYNOS_MIPI_VIDEO is not set
CONFIG_EXT2_FS=y
CONFIG_EXT3_FS=y
CONFIG_FANOTIFY=y
CONFIG_FANOTIFY_ACCESS_PERMISSIONS=y
CONFIG_QUOTA=y
CONFIG_AUTOFS4_FS=y
CONFIG_FUSE_FS=y
CONFIG_CUSE=y
CONFIG_TMPFS=y
CONFIG_HUGETLBFS=y
CONFIG_EFIVAR_FS=y
# CONFIG_MISC_FILESYSTEMS is not set
CONFIG_NLS_CODEPAGE_437=y
CONFIG_NLS_ISO8859_1=y
CONFIG_PRINTK_TIME=y
CONFIG_DEBUG_INFO=y
CONFIG_DEBUG_FS=y
CONFIG_MAGIC_SYSRQ=y
CONFIG_DEBUG_KERNEL=y
CONFIG_DETECT_HUNG_TASK=y
# CONFIG_SCHED_DEBUG is not set
# CONFIG_RCU_TRACE is not set
# CONFIG_FTRACE is not set
CONFIG_PID_IN_CONTEXTIDR=y
CONFIG_KEYS=y
CONFIG_SECURITY=y
CONFIG_CRYPTO_AUTHENC=y
CONFIG_CRYPTO_CBC=y
CONFIG_CRYPTO_HMAC=y
CONFIG_CRYPTO_MD5=y
CONFIG_CRYPTO_SHA256=y
CONFIG_CRYPTO_SHA512=y
CONFIG_CRYPTO_DES=y
CONFIG_CRYPTO_ANSI_CPRNG=y
# CONFIG_CRYPTO_HW is not set
CONFIG_ARM64_CRYPTO=y
CONFIG_CRYPTO_SHA1_ARM64_CE=y
CONFIG_CRYPTO_SHA2_ARM64_CE=y
CONFIG_CRYPTO_GHASH_ARM64_CE=y
CONFIG_CRYPTO_AES_ARM64_CE_CCM=y
CONFIG_CRYPTO_AES_ARM64_CE_BLK=y
CONFIG_CRYPTO_AES_ARM64_NEON_BLK=y
CONFIG_CRC_ITU_T=y
CONFIG_CRC7=y
CONFIG_GPIOLIB=y
CONFIG_HAS_IOMEM=y
CONFIG_OF_GPIO=y
CONFIG_GPIO_MPC8XXX=y
```

## bluebox3.its
```
/dts-v1/;

/ {
    description = "LX2160A-BlueBox3 Linux Kernel";
#address-cells = <1>;

    images {
	 kernel@1 {
	     description = "ARM64 Linux kernel";
	     data = /incbin/("./arch/arm64/boot/Image.gz");
	     type = "kernel";
	     arch = "arm64";
	     os = "linux";
	     compression = "gzip";
	     load = <0x80080000>;
	     entry = <0x80080000>;
	 };
	 fdt@1 {
	     description = "Flattened Device Tree blob";
	     data = /incbin/("./arch/arm64/boot/dts/freescale/fsl-lx2160a-bluebox3.dtb");
	     type = "flat_dt";
	     arch = "arm64";
	     compression = "none";
	     load = <0x90000000>;
	 };
	 ramdisk@1 {
	     description = "LX2 Ramdisk";
	     data = /incbin/("./rootfs_new.cpio.gz");
	     type = "ramdisk";
	     arch = "arm64";
	     compression = "none";
	     os = "linux";
	 };
    };

    configurations {
	 default = "config@1";
	 config@1 {
	     description = "Boot Linux kernel";
	     kernel = "kernel@1";
	     fdt = "fdt@1";
	     ramdisk = "ramdisk@1";
	 };
    };
};
```

## drivers/mxc/Kconfig
```kconfig
# drivers/mxc/Kconfig

if ARCH_LAYERSCAPE

menu "MXC support drivers"

# drivers common to MXC and LS1028A go here:
source "drivers/mxc/hdp/Kconfig"

endmenu

endif
```

## drivers/net/dsa/hms/Kconfig
```kconfig
# SPDX-License-Identifier: GPL-2.0-only

config NET_DSA_HMS_SWITCH
	tristate "NXP HMS Ethernet switch family support"
	depends on NET_DSA && SPI
	select NET_DSA_TAG_HMS
	help
	  This is the driver for the NXP ENTC Ethernet switch family.
	  These are managed over an SPI interface. Probing is handled
	  based on OF bindings and so is the linkage to PHYLINK.

config NET_DSA_HMS_PTP
	bool "Support for the PTP clock on the NXP HMS Ethernet switch"
	depends on NET_DSA_HMS_SWITCH
	depends on PTP_1588_CLOCK
	help
	  This enables support for timestamping and PTP clock manipulations in
	  the HMS DSA driver.
```

## drivers/net/ethernet/freescale/enetc/Kconfig
```kconfig
config FSL_ENETC
	tristate "ENETC PF driver"
	depends on PCI
	---help---
	  TBD

config FSL_ENETC_VF
	tristate "ENETC VF driver"
	depends on PCI
	---help---
	  TBD

config FSL_ENETC_PTP_CLOCK
	tristate "ENETC PTP clock driver"
	depends on FSL_ENETC || FSL_ENETC_VF
	select PTP_1588_CLOCK
	---help---
	  This driver adds support for using the ENETC 1588 timer
	  as a PTP clock. This clock is only useful if your PTP
	  programs are getting hardware time stamps on the PTP Ethernet
	  packets using the SO_TIMESTAMPING API.

	  To compile this driver as a module, choose M here: the module
	  will be called fsl-enetc-ptp.

config FSL_ENETC_HW_TIMESTAMPING
	bool "ENETC hardware timestamping support"
	depends on FSL_ENETC || FSL_ENETC_VF
	select FSL_ENETC_PTP_CLOCK
	---help---
	  Enable hardware timestamping support on the Ethernet packets
	  using the SO_TIMESTAMPING API. Because the RX BD ring dynamic
	  allocation hasn't been supported and it's too expensive to use
	  extended RX BDs if timestamping isn't used, the option was used
	  to control hardware timestamping/extended RX BDs to be enabled
	  or not.

if FSL_ENETC

config ENETC_TSN
	bool "TSN Support for NXP ENETC driver"
	default n
	depends on TSN
	---help---
	  This driver supports TSN on Freescale ENETC driver.
endif
```

## drivers/net/ethernet/freescale/fman/Kconfig
```kconfig
config FSL_FMAN
	tristate "FMan support"
	depends on ARCH_LAYERSCAPE || FSL_SOC || COMPILE_TEST
	select GENERIC_ALLOCATOR
	select PHYLIB
	default n
	help
		Freescale Data-Path Acceleration Architecture Frame Manager
		(FMan) support
```

## drivers/net/ethernet/mscc/Kconfig
```kconfig
# SPDX-License-Identifier: (GPL-2.0 OR MIT)
config NET_VENDOR_MICROSEMI
	bool "Microsemi devices"
	default y
	help
	  If you have a network (Ethernet) card belonging to this class, say Y.

	  Note that the answer to this question doesn't directly affect the
	  kernel: saying N will just cause the configurator to skip all
	  the questions about Microsemi devices.

if NET_VENDOR_MICROSEMI

config MSCC_OCELOT_SWITCH
	tristate "Ocelot switch driver"
	depends on NET_SWITCHDEV
	depends on HAS_IOMEM
	select PHYLIB
	select REGMAP_MMIO
	help
	  This driver supports the Ocelot network switch device.

config MSCC_OCELOT_SWITCH_OCELOT
	tristate "Ocelot switch driver on Ocelot"
	depends on MSCC_OCELOT_SWITCH
	depends on GENERIC_PHY
	depends on OF_NET
	help
	  This driver supports the Ocelot network switch device as present on
	  the Ocelot SoCs.

config MSCC_FELIX_SWITCH
	tristate "Felix switch driver"
	depends on MSCC_OCELOT_SWITCH
	depends on PCI
	help
	  This driver supports the Felix network switch device, connected as a
	  PCI device.

config MSCC_FELIX_SWITCH_PTP_CLOCK
	bool "Felix switch PTP clock driver"
	depends on MSCC_FELIX_SWITCH
	imply PTP_1588_CLOCK
	default y
	help
	  This driver supports the PTP clock on Felix network switch
	  device. This clock is only useful if your PTP programs are
	  getting hardware time stamps on the PTP Ethernet packets
	  using the SO_TIMESTAMPING API.

config MSCC_FELIX_SWITCH_TSN
	tristate "TSN on FELIX switch driver"
	depends on MSCC_FELIX_SWITCH
	depends on TSN
	help
	  This driver supports TSN on felix switch.

endif # NET_VENDOR_MICROSEMI
```

## drivers/nfc/pn5xx/Kconfig
```kconfig
config NFC_NXP_PN5XX
	tristate "NXP PN5XX based driver"
	depends on I2C
	select CRC_CCITT
	default m
	help
	  NXP PN5XX driver based on I2C.
	  This is a driver to provides I2C access to PN5xx and PN7120 NFC
	  Controller devices

	  To compile this driver as a module, choose m here. The module will
	  be called pn5xx_i2c.
	  Say N if unsure.
```
