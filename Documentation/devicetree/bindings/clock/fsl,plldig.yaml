## Documentation/devicetree/bindings/clock/fsl,plldig.yaml
```yaml
# SPDX-License-Identifier: GPL-2.0
%YAML 1.2
---
$id: http://devicetree.org/schemas/bindings/clock/fsl,plldig.yaml#
$schema: http://devicetree.org/meta-schemas/core.yaml#

title: NXP QorIQ Layerscape LS1028A Display PIXEL Clock Binding

maintainers:
  - Wen He <wen.he_1@nxp.com>

description: |
  NXP LS1028A has a clock domain PXLCLK0 used for the Display output
  interface in the display core, as implemented in TSMC CLN28HPM PLL.
  which generate and offers pixel clocks to Display.

properties:
  compatible:
    const: fsl,ls1028a-plldig

  reg:
    maxItems: 1

  '#clock-cells':
    const: 0

required:
  - compatible
  - reg
  - clocks
  - '#clock-cells'

examples:
  # Display PIXEL Clock node:
  - |
    dpclk: clock-display@f1f0000 {
        compatible = "fsl,ls1028a-plldig";
        reg = <0x0 0xf1f0000 0x0 0xffff>;
        #clock-cells = <0>;
        clocks = <&osc_27m>;
    };

...
```

## Documentation/devicetree/bindings/display/fsl,hdp.txt
```
NXP Layerscpae ls1028a HDP-TX PHY Controller
============================================

The following bindings describe the Cadence HDP TX PHY on ls1028a that
offer multi-protocol support of standars such as eDP and Displayport,
supports for 25-600MHz pixel clock and up to 4k2k at 60MHz resolution.
The HDP transmitter is a Cadence HDP TX controller IP with a companion
PHY IP.

Required properties:
  - compatible:   Should be "fsl,ls1028a-dp" for ls1028a.
  - reg:          Physical base address and size of the block of registers used
  by the processor.
  - interrupts:   HDP hotplug in/out detect interrupt number
  - clocks:       A list of phandle + clock-specifier pairs, one for each entry
  in 'clock-names'
  - clock-names:  A list of clock names. It should contain:
      - "clk_ipg": inter-Integrated circuit clock
      - "clk_core": for the Main Display TX controller clock
      - "clk_pxl": for the pixel clock feeding the output PLL of the processor
      - "clk_pxl_mux": for the high PerfPLL bypass clock
      - "clk_pxl_link": for the link rate pixel clock
      - "clk_apb": for the APB interface clock
      - "clk_vif": for the Video pixel clock

Required sub-nodes:
  - port: The HDP connection to an encoder output port. The connection
    is modelled using the OF graph bindings specified in
    Documentation/devicetree/bindings/graph.txt


Example:

/ {
        ...

        display1: hdp@f200000 {
                compatible = "fsl,ls1028a-dp";
		reg = <0x0 0xf1f0000 0x0 0xffff>,
		    <0x0 0xf200000 0x0 0xfffff>;
                interrupts = <0 221 IRQ_TYPE_LEVEL_HIGH>;
		clocks = <&sysclk>, <&hdpclk>, <&dpclk>,
                         <&dpclk>, <&dpclk>, <&pclk>, <&dpclk>;
		clock-names = "clk_ipg", "clk_core", "clk_pxl",
                              "clk_pxl_mux", "clk_pxl_link", "clk_apb",
                              "clk_vif";

		port {
			dp1_output: endpoint {
				remote-endpoint = <&dp0_input>;
			};
		};
        };

        ...
};
```

## Documentation/devicetree/bindings/dma/fsl-qdma.txt
```
* Freescale queue Direct Memory Access(qDMA) Controller

The qDMA supports channel virtualization by allowing DMA jobs to be enqueued into
different command queues. Core can initiate a DMA transaction by preparing a command
descriptor for each DMA job and enqueuing this job to a command queue.

* qDMA Controller
Required properties:
- compatible :
	should be "fsl,ls1021a-qdma".
- reg : Specifies base physical address(s) and size of the qDMA registers.
	The 1st region is qDMA control register's address and size.
	The 2nd region is status queue control register's address and size.
	The 3rd region is virtual block control register's address and size.
- interrupts : A list of interrupt-specifiers, one for each entry in
	interrupt-names.
- interrupt-names : Should contain:
	"qdma-queue0" - the block0 interrupt
	"qdma-queue1" - the block1 interrupt
	"qdma-queue2" - the block2 interrupt
	"qdma-queue3" - the block3 interrupt
	"qdma-error"  - the error interrupt
- channels : Number of DMA channels supported
- block-number : the virtual block number
- block-offset : the offset of different virtual block
- queues : the number of command queue per virtual block
- status-sizes : status queue size of per virtual block
- queue-sizes : command queue size of per virtual block, the size number based on queues
- big-endian: If present registers and hardware scatter/gather descriptors
	of the qDMA are implemented in big endian mode, otherwise in little
	mode.

Examples:
	qdma: qdma@8390000 {
				compatible = "fsl,ls1021a-qdma";
				reg = <0x0 0x8388000 0x0 0x1000>, /* Controller regs */
				      <0x0 0x8389000 0x0 0x1000>, /* Status regs */
				      <0x0 0x838a000 0x0 0x2000>; /* Block regs */
				interrupts = <GIC_SPI 185 IRQ_TYPE_LEVEL_HIGH>,
					     <GIC_SPI 76 IRQ_TYPE_LEVEL_HIGH>,
					     <GIC_SPI 77 IRQ_TYPE_LEVEL_HIGH>;
				interrupt-names = "qdma-error",
					"qdma-queue0", "qdma-queue1";
				channels = <8>;
				block-number = <2>;
				block-offset = <0x1000>;
				queues = <2>;
				status-sizes = <64>;
				queue-sizes = <64 64>;
				big-endian;
			};
```

## Documentation/devicetree/bindings/hwmon/emc2305.txt
```
EMC2305 (I2C)

This device is a RPM-based PWM Fan Speed Controller for up to 5 fans.
Each fan can be configured individually:

 - The PWM mode:
    0: Direct setting mode
    3: Fan speed control mode

 - The fan divisor (for Fan speed control mode)
   1, 2 ,4 or 8

 - The target RPM speed (for Fan speed control mode)
   max 16000 (according to data sheet)

 - The /emc2305 node

   Required properties:

   - compatible : must be "smsc,emc2305"
   - reg : I2C bus address of the device
   - #address-cells : must be <1>
   - #size-cells : must be <0>

   Example EMC2305 node:

       emc2305@2C {
	    compatible = "smsc,emc2305";
	    reg = <0x2C>;
	    #address-cells = <1>;
	    #size-cells = <0>;
       }
```

## Documentation/devicetree/bindings/interrupt-controller/fsl,ls-scfg-msi.txt
```
* Freescale Layerscape SCFG PCIe MSI controller

Required properties:

- compatible: should be "fsl,<soc-name>-msi" to identify
	      Layerscape PCIe MSI controller block such as:
              "fsl,ls1021a-msi"
              "fsl,ls1043a-msi"
              "fsl,ls1046a-msi"
              "fsl,ls1043a-v1.1-msi"
- msi-controller: indicates that this is a PCIe MSI controller node
- reg: physical base address of the controller and length of memory mapped.
- interrupts: A interrupt of the controller.

Each PCIe node needs to have property msi-parent that points to
MSI controller node

Examples:

	msi1: msi-controller@1571000 {
		compatible = "fsl,ls1043a-msi";
		reg = <0x0 0x1571000 0x0 0x8>,
		msi-controller;
		interrupts = <0 116 0x4>;
	};
```

## Documentation/devicetree/bindings/mailbox/arm,sgi-mbox.yaml
```yaml
# SPDX-License-Identifier: (GPL-2.0-only OR BSD-2-Clause)
%YAML 1.2
---
$id: http://devicetree.org/schemas/mailbox/arm,sgi-mbox.yaml#
$schema: http://devicetree.org/meta-schemas/core.yaml#

title: ARM SGI Mailbox

maintainers:
  - Hou Zhiqiang <Zhiqiang.Hou@nxp.com>

description: |
  The SGI Mailbox is a virtual device, which uses SGI interrupt to
  notify remote side and share memory for device MMIO registers.

properties:
  compatible:
    oneOf:
      - const: fsl,arm-sgi-mbox
  reg:
    maxItems: 1

  "#mbox-cells":
    description: |
      <&phandle type channel>
      phandle   : Label name of controller
      type      : Channel type
      channel   : Channel index

      This mailbox support 3 type of unidirectional channels, each type
      has 4 channels. A total of 12 channels. Following types are
      supported:
      0 - TX channel with 32bit transmit register
      1 - RX channel with 32bit receive register and IRQ support
      2 - RX doorbell channel.
    const: 2

required:
  - compatible
  - reg
  - "#mbox-cells"

additionalProperties: false

examples:
  - |
    reserved-memory {
        sgi-mbox@b8500000 {
            no-map;
            reg = <0 0xb8500000 0 0x1000>;
        };
    };

    sgi-mailbox@b8500000 {
        compatible = "fsl,arm-sgi-mbox";
        reg = <0 0xb8500000 0 0x1000>;
        #mbox-cells = <2>;
    };
```

## Documentation/devicetree/bindings/mailbox/generic-software-mbox.yaml
```yaml
# SPDX-License-Identifier: (GPL-2.0-only OR BSD-2-Clause)
%YAML 1.2
---
$id: http://devicetree.org/schemas/mailbox/generic-software-mbox.yaml#
$schema: http://devicetree.org/meta-schemas/core.yaml#

title: Generic Software Mailbox

maintainers:
  - Hou Zhiqiang <Zhiqiang.Hou@nxp.com>

description: |
  The Generic Software Mailbox is a virtual device, which uses unused
  interrupt line to notify remote side and shared memory to emulate
  device MMIO registers.

properties:
  compatible:
    oneOf:
      - const: fsl,generic-software-mbox
  reg:
    maxItems: 1

  "#mbox-cells":
    description: |
      <&phandle type channel>
      phandle   : Label name of controller
      type      : Channel type
      channel   : Channel index

      This mailbox support 3 type of unidirectional channels, each type
      has 32 channels. Following types are supported:
      0 - TX channel with 32bit transmit register
      1 - RX channel with 32bit receive register and IRQ support
      2 - RX doorbell channel.
    const: 2

required:
  - compatible
  - reg
  - "#mbox-cells"
  - interrupts
  - interrupt-names

additionalProperties: false

examples:
  - |
    reserved-memory {
        gen-sw-mbox@b8500000 {
            no-map;
            reg = <0 0xb8500000 0 0x1000>;
        };
    };

    generic-software-mailbox@b8500000 {
        compatible = "fsl,generic-software-mbox";
        reg = <0 0xb8500000 0 0x1000>;
        #mbox-cells = <2>;
        interrupts = <GIC_SPI 76 IRQ_TYPE_LEVEL_HIGH>,
                     <GIC_SPI 77 IRQ_TYPE_LEVEL_HIGH>;
        interrupt-names = "irq", "remote_irq";
    };
```

## Documentation/devicetree/bindings/mtd/nxp-flexspi.txt
```
* NXP Flex Serial Peripheral Interface(FlexSPI)

Required properties:
  - compatible : Should be "nxp,lx2160a-fspi"
  - reg : the first contains the register location and length,
          the second contains the memory mapping address and length
  - reg-names: Should contain the reg names "FSPI" and "FSPI-memory"
  - interrupts : Should contain the interrupt for the device
  - clocks : The clocks needed by the FlexSPI controller
  - clock-names : Should contain the name of the clocks: "fspi_en" and "fspi"

Optional properties:
  - nxp,fspi-has-second-chip: The controller has two buses, bus A and bus B.
			      Each bus can be connected with two NOR flashes.
			      Most of the time, each bus only has one NOR flash
			      connected, this is the default case.
			      But if there are two NOR flashes connected to the
			      bus, you should enable this property.
			      (Please check the board's schematic.)
Example:
fspi0: flexspi@20c0000 {
	compatible = "nxp,lx2160a-fspi";
	reg = <0x0 0x20c0000 0x0 0x10000>, <0x0 0x20000000 0x0 0x10000000>;
	reg-names = "FSPI", "FSPI-memory";
	interrupts = <0 25 0x4>; /* Level high type */
	clocks = <&clockgen 4 3>, <&clockgen 4 3>;
	clock-names = "fspi_en", "fspi";

	status = "okay";
	nxp,fspi-has-second-chip;
	flash0: mt35xu512aba@0 {
		reg = <0>;
		....
	};

	flash1: mt35xu512aba@1 {
		reg = <1>;
		....
	};

};
```

## Documentation/devicetree/bindings/mux/reg-mux.txt
```
Generic register bitfield-based multiplexer controller bindings

Define register bitfields to be used to control multiplexers. The parent
device tree node must be a device node to provide register r/w access.

Required properties:
- compatible : "reg-mux"
- #mux-control-cells : <1>
- mux-reg-masks : an array of register offset and pre-shifted bitfield mask
                  pairs, each describing a single mux control.
* Standard mux-controller bindings as decribed in mux-controller.txt

Optional properties:
- idle-states : if present, the state the muxes will have when idle. The
		special state MUX_IDLE_AS_IS is the default.

The multiplexer state of each multiplexer is defined as the value of the
bitfield described by the corresponding register offset and bitfield mask pair
in the mux-reg-masks array.

Example:

&i2c0 {
	fpga@66 { // fpga connected to i2c
		compatible = "fsl,lx2160aqds-fpga", "fsl,fpga-qixis-i2c",
			     "simple-mfd";
		reg = <0x66>;

		mux: mux-controller { // Mux Producer
			compatible = "reg-mux";
			#mux-control-cells = <1>;
			mux-reg-masks = <0x54 0xf8>, /* 0: reg 0x54, bits 7:3 */
					<0x54 0x07>; /* 1: reg 0x54, bits 2:0 */
		};
	};
};

mdio-mux-1 { // Mux consumer
	compatible = "mdio-mux";
	mux-controls = <&mux 0>;
	mdio-parent-bus = <&emdio1>;
	#address-cells = <1>;
	#size-cells = <0>;

	mdio@0 {
		reg = <0x0>;
		#address-cells = <1>;
		#size-cells = <0>;
	};

	mdio@8 {
		reg = <0x8>;
		#address-cells = <1>;
		#size-cells = <0>;
	};

	..
	..
};

mdio-mux-2 { // Mux consumer
	compatible = "mdio-mux";
	mux-controls = <&mux 1>;
	mdio-parent-bus = <&emdio2>;
	#address-cells = <1>;
	#size-cells = <0>;

	mdio@0 {
		reg = <0x0>;
		#address-cells = <1>;
		#size-cells = <0>;
	};

	mdio@1 {
		reg = <0x1>;
		#address-cells = <1>;
		#size-cells = <0>;
	};

	..
	..
};
```

## Documentation/devicetree/bindings/net/can/fsl-flexcan.txt
```
Flexcan CAN controller on Freescale's ARM and PowerPC system-on-a-chip (SOC).

Required properties:

- compatible : Should be "fsl,<processor>-flexcan"

  An implementation should also claim any of the following compatibles
  that it is fully backwards compatible with:

  - fsl,p1010-flexcan

- reg : Offset and length of the register set for this device
- interrupts : Interrupt tuple for this device

Clocking information is must for flexcan. please refer below info for
understanding clocking in flexcan:

• The FLEXCAN module is divided into two blocks. Controller host interface
  ("CHI") and Protocol Engine ("PE")
• Both these blocks require clock.
• CHI is responsible for registers read write including MB read/write.
  While PE is responsible for Transfer/receive data on CAN bus.
• The clocks feeding to these two blocks can be synchronous (i.e. same clock)
  or asynchronous (i.e. separate clocks).
• Selection is made in the CLK_SRC bit (bit 13) of Control 1 Register.
  - CLK_SRC = 0, asynchronous i.e. separate clocks for CHI and PE
  - CLK_SRC = 1, synchronous i.e. CHI clock is used for PE and PE
                 clock is not used.
• If this bit is not implemented in SOC, then SOC only supports asynchronous
  clocks.
• Either of the clock can be generated by any of the clock source.
• When the two clocks are asynchronous, then following restrictions apply to
  PE clock.
  - PE clock must be less than CHI clock.
• If low jitter is required on CAN bus, dedicated oscillator can be used to
  provide PE clock, but it must be less than CHI clock.

Base on above information clocking info in flexcan can be defined in two ways:

Method 1(Preferred):
  - clocks: phandle to the clocks feeding the flexcan. Two can be given:
    - "ipg": Protocol Engine clock
    - "per": Controller host interface clock
  - clock-names: Must contain the clock names described just above.

Method 2(Not Preferred):
  - clock-frequency : The synchronous clock frequency supplied to both
  Controller host interface and Protocol Engine

Optional properties:

- xceiver-supply: Regulator that powers the CAN transceiver

Example:

	can@1c000 {
		compatible = "fsl,p1010-flexcan";
		reg = <0x1c000 0x1000>;
		interrupts = <48 0x2>;
		interrupt-parent = <&mpic>;
		clock-frequency = <200000000>; // filled in by bootloader
	};

	can@2180000 {
		compatible = "fsl,lx2160ar1-flexcan";
		reg = <0x0 0x2180000 0x0 0x10000>;
		interrupts = <GIC_SPI 21 IRQ_TYPE_LEVEL_HIGH>;
		clocks = <&sysclk>, <&clockgen 4 7>;
		clock-names = "ipg", "per";
		status = "disabled";
	};
```
