## Documentation/devicetree/bindings/display/bridge/ite,it6251.yaml
```yaml
# SPDX-License-Identifier: GPL-2.0-only OR BSD-2-Clause
%YAML 1.2
---
$id: http://devicetree.org/schemas/display/bridge/ite,it6251.yaml#
$schema: http://devicetree.org/meta-schemas/core.yaml#

title: ITE IT6251 LVDS-to-eDP bridge bindings

maintainers:
  - Marek Vasut <marex@denx.de>
  - Richard Marko <srk@48.io>

description: |
  The IT6251 is a high-performance single-chip
  De-SSC LVDS to DisplayPort converter.
  Combined with LVDS receiver and DisplayPort Transmitter,
  the IT6251 supports LVDS input and DisplayPort 1.1a
  output by conversion function.

properties:
  compatible:
    const: ite,it6251

  reg:
    items:
      - description: I2C address of the bridge
      - description: I2C address of the LVDS part

  reg-names:
    items:
      - const: bridge
      - const: lvds

  ports:
    type: object

    properties:
      "#address-cells":
        const: 1

      "#size-cells":
        const: 0

      port@0:
        type: object
        description: |
         Video port for eDP output (typically panel).

      port@1:
        type: object
        description: |
          Video port for LVDS input.

    required:
      - port@0
      - port@1

    additionalProperties: false

  power-supply: true

  interrupts:
    maxItems: 1
    description: |
      Optional interrupt from the HPD/status pin of the bridge.

  ite,single-pixel-input:
    type: boolean
    description: |
      When present, the LVDS input uses single-pixel mode (one pixel per
      clock cycle). By default, dual-pixel mode is assumed, which is
      required for 1920x1080 operation on LATU boards.

  ite,color-depth:
    $ref: /schemas/types.yaml#/definitions/uint32
    enum: [6, 8, 10, 12]
    default: 8
    description: |
      LVDS input color depth in bits per component.
      Supported values: 6, 8, 10, 12. Defaults to 8.

  ite,dp-lanes:
    $ref: /schemas/types.yaml#/definitions/uint32
    enum: [1, 2, 4]
    default: 4
    description: |
      Number of DisplayPort output lanes. Defaults to 4.

  ite,dp-spread-spectrum:
    type: boolean
    description: |
      Enable spread-spectrum clocking on the DP output.

  ite,force-lbr:
    type: boolean
    description: |
      Force Low Bit Rate (LBR, 1.62 Gbps) link training instead of
      the default HBR (2.7 Gbps). Use when the downstream sink does
      not support HBR.

required:
  - compatible
  - reg
  - reg-names
  - power-supply
  - ports

additionalProperties: false

examples:
  - |
    it6251@5c {
      compatible = "ite,it6251";
      reg = <0x5c>, <0x5e>;
      reg-names = "bridge", "lvds";
      power-supply = <&reg_display>;

      ports {
        #address-cells = <1>;
        #size-cells = <0>;

        port@0 {
          reg = <0>;
          bridge_out_edp0: endpoint {
            remote-endpoint = <&panel_in_edp0>;
          };
        };

        port@1 {
          reg = <1>;
          bridge_in_lvds0: endpoint {
            remote-endpoint = <&lvds0_out>;
          };
        };
      };
    };
```

## drivers/media/platform/stream2v4l2/Kconfig
```kconfig
# SPDX-License-Identifier: GPL-2.0-only
# Copyright 2026 NXP
config VIDEO_STREAM2V4L2
    tristate "PCIe EP framebuffer to V4L2 capture bridge (iKVM)"
    depends on MEDIA_SUPPORT && VIDEO_DEV
    depends on PCI_EPF_IMX9_VGA
    select VIDEOBUF2_CORE
    select VIDEOBUF2_DMA_CONTIG
    default m
    help
      Say Y or M here to expose the i.MX9 PCIe endpoint framebuffer
      as a V4L2 capture device for OpenBMC iKVM.

      This driver reads the VRAM framebuffer address from the VGA EPF
      driver (pci-epf-imx9-vga) via pci_epf_get_vram_fb_address() and uses
      the DPU95 blit engine for zero-copy BGRX->RGBX conversion into
      DMA-contiguous V4L2 capture buffers.

      Requires CONFIG_PCI_EPF_VGA=y or =m.
```

## drivers/net/ethernet/freescale/enetc_ecat/Kconfig
```kconfig
# SPDX-License-Identifier: GPL-2.0
config FSL_ECAT_ENETC_CORE
    tristate
    help
      This module supports common functionality between the PF and VF
      drivers for the NXP ENETC controller.

      If compiled as module (M), the module name is fsl-ecat-enetc-core.

config FSL_ECAT_ENETC4
    tristate "ENETC4 PF native driver"
    depends on PCI_MSI && NXP_NETC_BLK_CTRL
    select MDIO_DEVRES
    select FSL_ECAT_ENETC_CORE
    select FSL_ENETC_MDIO
    select NXP_NETC_LIB
    select PHYLINK
    select PCS_LYNX
    select PCS_XPCS
    select DIMLIB
    select CRC_ITU_T
    select NET_DEVLINK
    help
      This driver supports the revision 4 of NXP ENETC (Fast Ethernet Controller)
      PCIe physical function (PF) devices, managing ENETC Ports at a
      privileged level.

      If compiled as module (M), the module name is fsl-ecat-enetc4.
```

## drivers/pci/endpoint/functions/Kconfig
```kconfig
# SPDX-License-Identifier: GPL-2.0
#
# PCI Endpoint Functions
#

config PCI_EPF_TEST
	tristate "PCI Endpoint Test driver"
	depends on PCI_ENDPOINT
	select CRC32
	help
	   Enable this configuration option to enable the test driver
	   for PCI Endpoint.

	   If in doubt, say "N" to disable Endpoint test driver.

config PCI_EPF_NTB
	tristate "PCI Endpoint NTB driver"
	depends on PCI_ENDPOINT
	select CONFIGFS_FS
	help
	  Select this configuration option to enable the Non-Transparent
	  Bridge (NTB) driver for PCI Endpoint. NTB driver implements NTB
	  controller functionality using multiple PCIe endpoint instances.
	  It can support NTB endpoint function devices created using
	  device tree.

	  If in doubt, say "N" to disable Endpoint NTB driver.

config PCI_EPF_VNTB
	tristate "PCI Endpoint Virtual NTB driver"
	depends on PCI_ENDPOINT
	depends on NTB
	select CONFIGFS_FS
	help
	  Select this configuration option to enable the Non-Transparent
	  Bridge (NTB) driver for PCIe Endpoint. NTB driver implements NTB
	  between PCI Root Port and PCIe Endpoint.

	  If in doubt, say "N" to disable Endpoint NTB driver.

config PCI_EPF_MHI
	tristate "PCI Endpoint driver for MHI bus"
	depends on PCI_ENDPOINT && MHI_BUS_EP
	help
	   Enable this configuration option to enable the PCI Endpoint
	   driver for Modem Host Interface (MHI) bus in Qualcomm Endpoint
	   devices such as SDX55.

	   If in doubt, say "N" to disable Endpoint driver for MHI bus.

config PCI_EPF_IMX9_VGA
	tristate "PCI Endpoint VGA Class Display driver (i.MX9 iKVM)"
	depends on PCI_ENDPOINT
	depends on OF
	select FIRMWARE_LOADER
	help
	  Enable this driver to expose the i.MX9 PCIe endpoint as a VGA
	  class display device for iKVM (IP-based KVM over PCIe) use cases.

	  Provides:
	    - BAR0 (0x10): 512B control registers (pcitest wire-format compatible)
	    - BAR1 (0x14): 512B EDID (DRM sysfs or 1080p/4K fallback blob)
	    - BAR2 (0x18): 64MB VRAM framebuffer (ioremap_wc, DT reserved-memory "vram")
	    - BAR3 (0x1C): 32KB PCIe HID ring buffer (keyboard + mouse reports)
	    - BAR4 (0x20): 4MB DPU95 register space (ioremap at 0x4b400000)
	    - BAR5 (0x24): 1MB reserved
	    - ROM  (0x30): Expansion ROM BAR (PCI_ROM_ADDRESS, not BAR6)
	                   Loaded via request_firmware(), min 64KB, pow2-aligned:
	                    pcie_video_usb_hid -> OptionRom.rom
	                    pcie_kvm          -> OptionRom_pcie_kvm.rom
	    - Resolution change uevent to userspace (RESOLUTION=WxH)
	    - KVM ready uevent to userspace (KVM_EVENT=kvm_ready)
	    - pci_epf_get_vram_fb_address() exported for stream2v4l2
	    - pci_epf_get_hid_address() exported for pcie-kvm-hid

	  This driver is independent of PCI_EPF_TEST.

	  If in doubt, say "N".
```

## drivers/pci/endpoint/functions/imx9_ikvm/Kconfig
```kconfig
# SPDX-License-Identifier: GPL-2.0
# Copyright 2026 NXP
#
# PCI Endpoint KVM input
#

config PCIE_KVM_INPUT
	tristate "PCIe EP capture HID input from remote and local input device (iKVM)"
	depends on PCI_EPF_IMX9_VGA
	depends on HID
	default y
	help
	  Say Y or M here to expose the i.MX9 PCIe endpoint HID device
	  for OpenBMC iKVM.

	  This driver reads HID data from the HID ring buffer and writes it to endpoint BAR3.

	  Requires CONFIG_PCI_EPF_IMX9_VGA=y or =m.
```

## kernel-imx8mp-sdr.its
```
/*
 * Copyright 2024-2025 NXP
 *
 * This file is licensed under the terms of the GNU General Public
 * License version 2.  This program is licensed "as is" without any
 * warranty of any kind, whether express or implied.
 */

/dts-v1/;

/ {
	description = "Image file for the imx8mp-sdr Linux Kernel";
	#address-cells = <1>;

	images {
		kernel {
			description = "ARM64 Linux kernel";
			data = /incbin/("./arch/arm64/boot/Image.gz");
			type = "kernel";
			arch = "arm64";
			os = "linux";
			compression = "gzip";
			load = <0x40400000>;
			entry = <0x40400000>;
		};
		fdt {
			description = "Flattened Device Tree blob";
			data = /incbin/("./arch/arm64/boot/dts/freescale/imx8mp-sdr.dtb");

			type = "flat_dt";
			arch = "arm64";
			compression = "none";
			load = <0x43000000>;
		};
		ramdisk {
			description = "imx8mp-sdr Ramdisk";
                        data = /incbin/("./core-image-minimal-dev-imx8mp-sdr.cpio.gz");
			type = "ramdisk";
			arch = "arm64";
			os = "linux";
			compression = "gzip";
		};
	};

	configurations {
		default = "config-1";
		config-1 {
			description = "Boot Linux kernel";
			kernel = "kernel";
			fdt = "fdt";
			ramdisk = "ramdisk";
		};
	};
};
```
