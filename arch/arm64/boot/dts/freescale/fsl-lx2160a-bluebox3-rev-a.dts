// SPDX-License-Identifier: (GPL-2.0 OR MIT)
//
// Device Tree file for LX2160A BLUEBOX3
//
// Copyright 2020 NXP

/dts-v1/;

#include "fsl-lx2160a-bluebox3.dts"

&sw1_mii3_phy {
	/* AR8035 PHY address */
	reg = <0x1>;
};

&sw2_mii3_phy {
	/* AR8035 PHY address */
	reg = <0x2>;
};
