// SPDX-License-Identifier: (GPL-2.0+ OR MIT)
/*
 * Copyright 2022-2023 NXP
 */

#include "imx8mp-evk-root.dts"
#include "imx8mp-rpmsg-ca53.dtsi"

&eqos {
	status = "disabled";
};

&flexcan1 {
	status = "disabled";
};
