// SPDX-License-Identifier: (GPL-2.0 OR MIT)
/*
 * Copyright 2024 NXP
 */

#include "imx8mp-evk.dts"

&fec {
    compatible = "fsl,imx8mp-fec-igh-native", "fsl,imx8mq-fec-igh-native", "fsl,imx6sx-fec-igh-native";
};
