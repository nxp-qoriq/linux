// SPDX-License-Identifier: (GPL-2.0 OR MIT)
/*
 * Copyright 2023 NXP
 */

/dts-v1/;

#include "imx8mp-evk-multicore-rtos.dts"

&fec {
	status = "disabled";
};

&eqos {
	/delete-property/ clocks;
	/delete-property/ clock-names;
	clocks = <&clk IMX8MP_CLK_QOS_ENET_ROOT>,
		 <&clk IMX8MP_CLK_ENET_QOS_TIMER>,
		 <&clk IMX8MP_CLK_ENET_QOS>;
	clock-names = "pclk", "ptp_ref", "tx";
};
