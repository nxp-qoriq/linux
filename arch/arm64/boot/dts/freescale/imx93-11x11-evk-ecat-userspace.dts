// SPDX-License-Identifier: GPL-2.0+
/*
 * Copyright 2024 NXP
 */

#include "imx93-11x11-evk.dts"

&ethphy2 {
	/delete-property/ reset-gpios;
	/delete-property/ reset-assert-us;
	/delete-property/ reset-deassert-us;
};

&fec {
	compatible = "fsl,imx8mm-fec-uio";
};
