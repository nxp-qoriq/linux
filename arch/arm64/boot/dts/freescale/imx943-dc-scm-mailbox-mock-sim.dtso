// SPDX-License-Identifier: GPL-2.0-only
/*
 * iMX943 DC-SCM - QSPI Mailbox overlay, SIMULATOR additions
 *
 * Includes imx943-dc-scm-mailbox-mock.dtso unchanged and adds only the
 * register windows that exist because a SIMULATOR is answering the mailbox
 * (server_sim / fpga_sim), not because the FPGA hardware requires them.
 *
 * WHY THIS FILE EXISTS
 *   The base overlay is the hardware description: it is what you boot for real
 *   FPGA bring-up (CONFIG_IMX9_QSPI_MB_MOCK=n). Keeping simulator-only
 *   properties out of it means a bring-up image never carries register
 *   addresses the silicon does not implement, and a bad simulator address can
 *   never break a hardware boot. It also makes review trivial: if a property is
 *   here, it is not a hardware claim.
 *
 * WHAT COUNTS AS "SIMULATOR-ONLY"
 *   The test is: would the property still be needed with a real FPGA and no
 *   simulator? If yes it belongs in the base overlay; if no it belongs here.
 *   Anything a userspace daemon can configure for itself should not be in
 *   either file - see the FRU identity note at the end.
 *
 * Build:
 *   make ARCH=arm64 \
 *     arch/arm64/boot/dts/freescale/imx943-dc-scm-mailbox-mock-sim.dtbo
 *
 * Boot - apply ONE of the two, not both. This overlay already contains
 * everything the base one does, so applying both would duplicate the nodes:
 *
 *   real FPGA bring-up:
 *     fdt apply ${dtbo_addr}   # imx943-dc-scm-mailbox-mock.dtbo
 *
 *   simulator on the bench:
 *     fdt apply ${dtbo_addr}   # imx943-dc-scm-mailbox-mock-sim.dtbo
 *
 * Copyright 2026 NXP
 */

#include "imx943-dc-scm-mailbox-mock.dtso"

/*
 * -- eSPI host power control -----------------------------------------------
 *
 * Bidirectional one-byte register. Writing it is a request; reading it returns
 * the observed host power state:
 *
 *   write  1 = on            read  0 = S5 (off)
 *          2 = graceful off        1 = S0 (running)
 *          3 = force off           2 = shutting down
 *          4 = graceful reset      3 = resetting
 *          5 = force reset
 *
 * This is what gives the BMC a real graceful path. The alternative - dropping a
 * GPIO enable line - can neither ask the host to shut itself down nor observe
 * whether it did, which is why "Graceful Restart" previously behaved as a force
 * restart. With this register the FPGA drives the ACPI sideband (SLP_S5 /
 * reset-warning), host firmware runs its own shutdown, and nxp_host_power.sh
 * polls the state to decide whether the request was honoured or needs
 * escalating to a force.
 *
 * It lives in the simulator overlay because only fpga_sim implements the
 * matching state machine today. When the FPGA gains the register, move this
 * property into the base overlay - the driver side (espi.c) needs no change,
 * since it treats the property as optional and simply does not create the
 * debugfs file when absent.
 *
 * 0x50 is the next address after the eSPI snapshot bank the base overlay
 * already describes (0x40..0x4F) and must match ESPI_HOST_CTRL_ADDR in
 * app/fpga_sim.c.
 */
&fpga_espi0 {
	nxp,host-ctrl-address = <0x50>;
};

