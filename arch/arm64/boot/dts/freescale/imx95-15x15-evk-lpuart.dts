// SPDX-License-Identifier: (GPL-2.0+ OR MIT)
/*
 * Copyright 2025 NXP
 */

#include "imx95-15x15-evk.dts"

/* Unbind lpuart5 from Bluetooth, use it for lpuart test. */
&lpuart5 {
    /delete-node/ bluetooth;
};

/*
 * uart test port1. Note: don't use Bluetooth at the sametime.
 * J27: Pin27--TX Pin28--RX
 */
&pinctrl_uart5 {
	fsl,pins = <
		IMX95_PAD_GPIO_IO00__LPUART5_TX				0x31e
		IMX95_PAD_GPIO_IO01__LPUART5_RX				0x31e
		IMX95_PAD_GPIO_IO02__LPUART5_CTS_B			0x31e
		IMX95_PAD_GPIO_IO03__LPUART5_RTS_B			0x31e
	>;
};

