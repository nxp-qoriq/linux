// SPDX-License-Identifier: (GPL-2.0 OR MIT)
/*
 * Copyright 2024 NXP
 */

/dts-v1/;
#include "imx95-19x19-evk.dts"
#include "imx95-rproc-ca55.dtsi"

/ {
	reserved-memory {
		#address-cells = <2>;
		#size-cells = <2>;
		ranges;

		/*
		 * Reserve up to 3 x 16MB for three possible FreeRTOS instances running on
		 * Cortex-A Cores when booting Linux.
		 */
		rtos_ca55_reserved: rtos-ca55@d0000000 {
			no-map;
			reg = <0 0xd0000000 0x0 0x3000000>;
		};
	};
};

&lpuart3 {
	status = "disabled";
};
