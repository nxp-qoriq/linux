// SPDX-License-Identifier: (GPL-2.0+ OR BSD-3-Clause)
/*
 * Copyright 2012-2015 Freescale Semiconductor, Inc.
 * Copyright 2017-2018 NXP
 *
 */

&qportals {
	qman-ceetm@0 {
		compatible = "fsl,qman-ceetm";
		fsl,ceetm-lfqid-range = <0xf00000 0x1000>;
		fsl,ceetm-sp-range = <0 16>;
		fsl,ceetm-lni-range = <0 8>;
		fsl,ceetm-channel-range = <0 8>;
	};
};
