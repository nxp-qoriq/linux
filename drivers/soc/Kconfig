## drivers/soc/Kconfig
```kconfig
menu "SOC (System On Chip) specific Drivers"

source "drivers/soc/brcmstb/Kconfig"
source "drivers/soc/mediatek/Kconfig"
source "drivers/soc/qcom/Kconfig"
source "drivers/soc/rockchip/Kconfig"
source "drivers/soc/sunxi/Kconfig"
source "drivers/soc/ti/Kconfig"
source "drivers/soc/versatile/Kconfig"

config	FSL_SOC_DRIVERS
	bool "Freescale Soc Drivers"
	default n
	help
	Say y here to enable Freescale Soc Device Drivers support.
	The Soc Drivers provides the device driver that is a specific block
	or feature on Freescale platform.

if FSL_SOC_DRIVERS
	source "drivers/soc/fsl/Kconfig"
	source "drivers/soc/fsl/qbman/Kconfig"
endif

endmenu
```

## drivers/soc/fsl/Kconfig
```kconfig
#
# Freescale SOC drivers
#

source "drivers/soc/fsl/qbman/Kconfig"
source "drivers/soc/fsl/qe/Kconfig"

config FSL_GUTS
	bool
	select SOC_BUS
	help
	  The global utilities block controls power management, I/O device
	  enabling, power-onreset(POR) configuration monitoring, alternate
	  function selection for multiplexed signals,and clock control.
	  This driver is to manage and access global utilities block.
	  Initially only reading SVR and registering soc device are supported.
	  Other guts accesses, such as reading RCW, should eventually be moved
	  into this driver as well.

config FSL_RCPM
	bool "Freescale RCPM support"
	depends on PM_SLEEP
	help
	  The NXP QorIQ Processors based on ARM Core have RCPM module
	  (Run Control and Power Management), which performs all device-level
	  tasks associated with power management, such as wakeup source control.

config FSL_QIXIS
	tristate "QIXIS system controller driver"
	depends on OF
	select REGMAP_I2C
	select REGMAP_MMIO
	select MFD_CORE
	default n
	help
	  Say y here to enable QIXIS system controller api. The qixis driver
	  provides FPGA functions to control system.

config FSL_SLEEP_FSM
	bool
	help
	  This driver configures a hardware FSM (Finite State Machine) for deep sleep.
	  The FSM is used to finish clean-ups at the last stage of system entering deep
	  sleep, and also wakes up system when a wake up event happens.
```

## drivers/soc/fsl/Kconfig.arm
```kconfig
#
# Freescale ARM SOC Drivers
#

config LS_SOC_DRIVERS
	bool "Layerscape Soc Drivers"
	depends on ARCH_LAYERSCAPE
	default n
	help
	Say y here to enable Freescale Layerscape Soc Device Drivers support.
	The Soc Drivers provides the device driver that is a specific block
	or feature on Layerscape platform.

if LS_SOC_DRIVERS
	source "drivers/soc/fsl/layerscape/Kconfig"
endif
```

## drivers/soc/fsl/layerscape/Kconfig
```kconfig
#
# Layerscape Soc drivers
#
config  FTM_ALARM
	bool "FTM alarm driver"
	default n
	help
	Say y here to enable FTM alarm support.  The FTM alarm provides
	alarm functions for wakeup system from deep sleep.  There is only
	one FTM can be used in ALARM(FTM 0).
```

## drivers/soc/fsl/ls2-console/Kconfig
```kconfig
config FSL_LS2_CONSOLE
        tristate "Layerscape MC and AIOP console support"
	depends on ARCH_LAYERSCAPE
        default y
```

## drivers/staging/fsl-dpaa2/Kconfig
```kconfig
#
# Freescale DataPath Acceleration Architecture Gen2 (DPAA2) drivers
#

config FSL_DPAA2
	bool "Freescale DPAA2 devices"
	depends on FSL_MC_BUS
	---help---
	  Build drivers for Freescale DataPath Acceleration
	  Architecture (DPAA2) family of SoCs.

config FSL_DPAA2_ETH
	tristate "Freescale DPAA2 Ethernet"
	depends on FSL_DPAA2 && FSL_MC_DPIO
	depends on NETDEVICES && ETHERNET
	---help---
	  Ethernet driver for Freescale DPAA2 SoCs, using the
	  Freescale MC bus driver

if FSL_DPAA2_ETH
config FSL_DPAA2_ETH_USE_ERR_QUEUE
	bool "Enable Rx error queue"
	default n
	---help---
	  Allow Rx error frames to be enqueued on an error queue
	  and processed by the driver (by default they are dropped
	  in hardware).
	  This may impact performance, recommended for debugging
	  purposes only.

config FSL_DPAA2_ETH_DCB
        bool "Data Center Bridging (DCB) Support"
        default n
        depends on DCB
        ---help---
          Say Y here if you want to use Data Center Bridging (DCB) features
          (PFC) in the driver.

          If unsure, say N.

config FSL_DPAA2_ETH_CEETM
	depends on NET_SCHED
	bool "DPAA2 Ethernet CEETM QoS"
	default n
	---help---
	  Enable QoS offloading support through the CEETM hardware block.

config FSL_DPAA2_PTP_CLOCK
	tristate "Freescale DPAA2 PTP Clock"
	depends on FSL_DPAA2_ETH && PTP_1588_CLOCK_QORIQ
	default y
	help
	  This driver adds support for using the DPAA2 1588 timer module
	  as a PTP clock.
endif

source "drivers/staging/fsl-dpaa2/mac/Kconfig"
source "drivers/staging/fsl-dpaa2/evb/Kconfig"

config FSL_DPAA2_ETHSW
	tristate "Freescale DPAA2 Ethernet Switch"
	depends on FSL_DPAA2
	depends on NET_SWITCHDEV
	---help---
	Driver for Freescale DPAA2 Ethernet Switch. Select
	BRIDGE to have support for bridge tools.
```

## drivers/staging/fsl-dpaa2/ethernet/Kconfig
```kconfig
#
# Freescale DPAA Ethernet driver configuration
#
# Copyright (C) 2014-2015 Freescale Semiconductor, Inc.
#
# This file is released under the GPLv2
#

menuconfig FSL_DPAA2_ETH
	tristate "Freescale DPAA2 Ethernet"
	depends on FSL_DPAA2 && FSL_MC_BUS && FSL_MC_DPIO
	select FSL_DPAA2_MAC
	default y
	---help---
	  Freescale Data Path Acceleration Architecture Ethernet
	  driver, using the Freescale MC bus driver.

if FSL_DPAA2_ETH

config FSL_DPAA2_ETH_USE_ERR_QUEUE
	bool "Enable Rx error queue"
	default n
	---help---
	  Allow Rx error frames to be enqueued on an error queue
	  and processed by the driver (by default they are dropped
	  in hardware).
	  This may impact performance, recommended for debugging
	  purposes only.

config FSL_DPAA2_ETH_DEBUGFS
	depends on DEBUG_FS && FSL_QBMAN_DEBUG
	bool "Enable debugfs support"
	default n
	---help---
	  Enable advanced statistics through debugfs interface.
endif
```

## drivers/staging/fsl-dpaa2/ethsw/Kconfig
```kconfig
config FSL_DPAA2_ETHSW
	tristate "DPAA2 Ethernet Switch"
	depends on FSL_MC_BUS && FSL_DPAA2
	default y
	---help---
	Prototype driver for DPAA2 Ethernet Switch.
```

## drivers/staging/fsl-dpaa2/evb/Kconfig
```kconfig
config FSL_DPAA2_EVB
	tristate "DPAA2 Edge Virtual Bridge"
	depends on FSL_MC_BUS && FSL_DPAA2 && FSL_DPAA2_ETH
	select FSL_DPAA2_MAC
	select VLAN_8021Q
	default y
	---help---
	Prototype driver for DPAA2 Edge Virtual Bridge.
```

## drivers/staging/fsl-mc/bus/Kconfig
```kconfig
#
# Freescale Management Complex (MC) bus drivers
#
# Copyright (C) 2014 Freescale Semiconductor, Inc.
#
# This file is released under the GPLv2
#

config FSL_MC_BUS
	bool "Freescale Management Complex (MC) bus driver"
	depends on OF && ARM64
	select GENERIC_MSI_IRQ_DOMAIN
	help
	  Driver to enable the bus infrastructure for the Freescale
          QorIQ Management Complex (fsl-mc). The fsl-mc is a hardware
	  module of the QorIQ LS2 SoCs, that does resource management
	  for hardware building-blocks in the SoC that can be used
	  to dynamically create networking hardware objects such as
	  network interfaces (NICs), crypto accelerator instances,
	  or L2 switches.

	  Only enable this option when building the kernel for
	  Freescale QorQIQ LS2xxxx SoCs.

config FSL_MC_RESTOOL
        tristate "Freescale Management Complex (MC) restool driver"
        depends on FSL_MC_BUS
        help
          Driver that provides kernel support for the Freescale Management
	  Complex resource manager user-space tool.

config FSL_MC_DPIO
	tristate "Freescale Data Path I/O (DPIO) driver"
	depends on FSL_MC_BUS
	help
	  Driver for Freescale Data Path I/O (DPIO) devices.
	  A DPIO device provides queue and buffer management facilities
	  for software to interact with other Data Path devices. This
	  driver does not expose the DPIO device individually, but
	  groups them under a service layer API.

config FSL_QBMAN_DEBUG
	tristate "Freescale QBMAN Debug APIs"
	depends on FSL_MC_DPIO
	help
	  QBMan debug assistant APIs.
```

## drivers/vfio/fsl-mc/Kconfig
```kconfig
config VFIO_FSL_MC
	tristate "VFIO support for Freescale Management Complex devices"
	depends on VFIO && FSL_MC_BUS && EVENTFD
	help
	  Support for the Freescale Management Complex(MC) VFIO driver.
	  This is required to passthrough Freescale MC devices using the
	  VFIO framework.

	  If you don't know what to do here, say N.
```

## its/kernel-ls2080a-rdb.its
```
/*
 * Copyright (C) 2015, Freescale Semiconductor
 *
 * Bhupesh Sharma <bhupesh.sharma@freescale.com>
 * Harninder Rai <harninder.rai@freescale.com>
 *
 * This file is licensed under the terms of the GNU General Public
 * License version 2.  This program is licensed "as is" without any
 * warranty of any kind, whether express or implied.
 */

/dts-v1/;

/ {
	description = "RDB Image file for the LS2080A Linux Kernel";
	#address-cells = <1>;

	images {
		kernel@1 {
			description = "ARM64 Linux kernel";
			data = /incbin/("../arch/arm64/boot/Image.gz");
			type = "kernel";
			arch = "arm64";
			os = "linux";
			compression = "gzip";
			load = <0x80080000>;
			entry = <0x80080000>;
		};
		fdt@1 {
			description = "Flattened Device Tree blob";
			data = /incbin/("../arch/arm64/boot/dts/freescale/fsl-ls2080a-rdb.dtb");
			type = "flat_dt";
			arch = "arm64";
			compression = "none";
			load = <0x90000000>;
		};
		ramdisk@1 {
			description = "LS2 Ramdisk";
			data = /incbin/("../fsl-image-core-ls2080ardb.ext2.gz");
			type = "ramdisk";
			arch = "arm64";
			os = "linux";
			compression = "none";
		};
	};

	configurations {
		default = "config@1";
		config@1 {
			description = "Boot Linux kernel";
			kernel = "kernel@1";
			fdt = "fdt@1";
			ramdisk = "ramdisk@1";
		};
	};
};
```

## kernel-la1238-rdb.its
```
/*
 * Copyright 2021-2022 NXP
 *
 * This file is licensed under the terms of the GNU General Public
 * License version 2.  This program is licensed "as is" without any
 * warranty of any kind, whether express or implied.
 */

/dts-v1/;

/ {
	description = "Image file for the LA1238(CPU side) Linux Kernel";
	#address-cells = <1>;

	images {
		kernel@1 {
			description = "ARM64 Linux kernel";
			data = /incbin/("./arch/arm64/boot/Image.gz");
			type = "kernel";
			arch = "arm64";
			os = "linux";
			compression = "gzip";
			load = <0x84080000>;
			entry = <0x84080000>;
		};
		fdt@1 {
			description = "Flattened Device Tree blob";
			data = /incbin/("./arch/arm64/boot/dts/freescale/fsl-la1238-rdb.dtb");

			type = "flat_dt";
			arch = "arm64";
			compression = "none";
			load = <0x90000000>;
		};
		ramdisk@1 {
			description = "LA1238 Ramdisk";
                        data = /incbin/("./rootfs_lsdk2012_yocto_devel_arm64.cpio.gz");
			type = "ramdisk";
			arch = "arm64";
			os = "linux";
			compression = "gzip";
		};
	};

	configurations {
		default = "config@1";
		config@1 {
			description = "Boot Linux kernel";
			kernel = "kernel@1";
			fdt = "fdt@1";
			ramdisk = "ramdisk@1";
		};
	};
};
```

## kernel-ls2088a-rdb.its
```
/*
 * Copyright (C) 2016, Freescale Semiconductor
 *
 * Abhimanyu Saini <abhimanyu.saini@nxp.com>
 *
 * This file is licensed under the terms of the GNU General Public
 * License version 2.  This program is licensed "as is" without any
 * warranty of any kind, whether express or implied.
 */

/dts-v1/;

/ {
	description = "RDB Image file for the LS2080A Linux Kernel";
	#address-cells = <1>;

	images {
		kernel@1 {
			description = "ARM64 Linux kernel";
			data = /incbin/("./arch/arm64/boot/Image.gz");
			type = "kernel";
			arch = "arm64";
			os = "linux";
			compression = "gzip";
			load = <0x80080000>;
			entry = <0x80080000>;
		};
		fdt@1 {
			description = "Flattened Device Tree blob";
			data = /incbin/("./arch/arm64/boot/dts/freescale/fsl-ls2088a-rdb.dtb");
			type = "flat_dt";
			arch = "arm64";
			compression = "none";
			load = <0x90000000>;
		};
		ramdisk@1 {
			description = "LS2 Ramdisk";
			data = /incbin/("./fsl-image-core-ls2088ardb.ext2.gz");
			type = "ramdisk";
			arch = "arm64";
			os = "linux";
			compression = "none";
		};
	};

	configurations {
		default = "config@1";
		config@1 {
			description = "Boot Linux kernel";
			kernel = "kernel@1";
			fdt = "fdt@1";
			ramdisk = "ramdisk@1";
		};
	};
};
```

## kernel-lx2160a-qds-interposer.its
```
/*
 * Copyright 2017-2018 NXP
 *
 * Santan kumar <santan.kumar@nxp.com>
 *
 * This file is licensed under the terms of the GNU General Public
 * License version 2.  This program is licensed "as is" without any
 * warranty of any kind, whether express or implied.
 */

/dts-v1/;

/ {
	description = "QDS Image file for the LX2160 Linux Kernel";
	#address-cells = <1>;

	images {
		kernel@1 {
			description = "ARM64 Linux kernel";
			data = /incbin/("./arch/arm64/boot/Image.gz");
			type = "kernel";
			arch = "arm64";
			os = "linux";
			compression = "gzip";
			load = <0x80080000>;
			entry = <0x80080000>;
		};
		fdt@1 {
			description = "Flattened Device Tree blob";
			data = /incbin/("./arch/arm64/boot/dts/freescale/fsl-lx2160a-qds-interposer.dtb");
			type = "flat_dt";
			arch = "arm64";
			compression = "none";
			load = <0x90000000>;
		};
		ramdisk@1 {
			description = "LS2 Ramdisk";
			data = /incbin/("./fsl-image-core-lx2160ardb.ext2.gz");
			type = "ramdisk";
			arch = "arm64";
			os = "linux";
			compression = "none";
			load = <0x98000000>;
		};
	};

	configurations {
		default = "config@1";
		config@1 {
			description = "Boot Linux kernel";
			kernel = "kernel@1";
			fdt = "fdt@1";
			ramdisk = "ramdisk@1";
		};
	};
};
```
